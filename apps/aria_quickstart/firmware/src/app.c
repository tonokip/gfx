/*******************************************************************************
  MPLAB Harmony Application Source File

  Company:
    Microchip Technology Inc.

  File Name:
    app.c

  Summary:
    This file contains the source code for the MPLAB Harmony application.

  Description:
    This file contains the source code for the MPLAB Harmony application.  It
    implements the logic of the application's state machine and it may call
    API routines of other MPLAB Harmony modules in the system, such as drivers,
    system services, and middleware.  However, it does not call any of the
    system interfaces (such as the "Initialize" and "Tasks" functions) of any of
    the modules in the system or make any assumptions about when those functions
    are called.  That is the responsibility of the configuration-specific system
    files.
 *******************************************************************************/

// *****************************************************************************
// *****************************************************************************
// Section: Included Files
// *****************************************************************************
// *****************************************************************************

#include "app.h"
#include "gfx/driver/processor/gfx2d/hpl_gpu.h"
#include "gfx/driver/processor/gfx2d/hal_gpu_async.h"

// *****************************************************************************
// *****************************************************************************
// Section: Global Data Definitions
// *****************************************************************************
// *****************************************************************************
/** Memory base address for EBI access example */
#define MEM_BASE 0x0 //SDRAM_CS_ADDR

#define COLOR_RED 0xFF0000
#define COLOR_GREEN 0x00FF00
#define COLOR_BLUE 0x0000FF

/* Number of Pixel Per line */
#define PPL 480 //CONF_LCDC_LCDCFG4_PPL
/* Number of Row Per Frame */
#define RPF 272 //CONF_LCDC_LCDCFG4_RPF
/* HEO window width in pixel */
#define HEO_PPL 480 * 32 //CONF_LCDC_HEOCFG3_XSIZE

/* Framebuffer, allocated at SDRAM space*/
uint32_t *fb = (uint32_t *)0x0; //SDRAM_CS_ADDR;
/* Microchip Logo, 50*50 pixel */
/* Microchip logo ARGB format */
uint32_t microchip_logo[50 * 50]
    = {0xFFFFFFFF, 0xFFFFFFFF, 0xFFFFFFFF, 0xFFFFFFFF, 0xFFFFFFFF, 0xFFFFFFFF, 0xFFFFFFFF, 0xFFFFFFFF, 0xFFFFFFFF,
       0xFFFFFFFF, 0xFFFFFFFF, 0xFFFFFFFF, 0xFFFFFFFF, 0xFFFFFFFF, 0xFFFFFFFF, 0xFFFFFFFF, 0xFFFFFFFF, 0xFFFFFFFF,
       0xFFFFFFFF, 0xFFFFFFFF, 0xFFFFFFFF, 0xFFFFFFFF, 0xFFFFFFFF, 0xFFFFFFFF, 0xFFFFFFFF, 0xFFFFFFFF, 0xFFFFFFFF,
       0xFFFFFFFF, 0xFFFFFFFF, 0xFFFFFFFF, 0xFFFFFFFF, 0xFFFFFFFF, 0xFFFFFFFF, 0xFFFFFFFF, 0xFFFFFFFF, 0xFFFFFFFF,
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       0xFFFFFFFF, 0xFFFFFFFF, 0xFFFFFFFF, 0xFFFFFFFF, 0xFFFFFFFF, 0xFFFFFFFF, 0xFFFFFFFF};


// *****************************************************************************
/* Application Data

  Summary:
    Holds application data

  Description:
    This structure holds the application's data.

  Remarks:
    This structure should be initialized by the APP_Initialize function.

    Application strings and buffers are be defined outside this structure.
*/

APP_DATA appData;

// *****************************************************************************
// *****************************************************************************
// Section: Application Callback Functions
// *****************************************************************************
// *****************************************************************************

/* TODO:  Add any necessary callback functions.
*/

// *****************************************************************************
// *****************************************************************************
// Section: Application Local Functions
// *****************************************************************************
// *****************************************************************************
static inline void next_color(uint32_t idx)
{
	if (fb[idx] == COLOR_RED) {
		fb[idx] = COLOR_BLUE;
	} else if (fb[idx] == COLOR_GREEN) {
		fb[idx] = COLOR_RED;
	} else {
		fb[idx] = COLOR_GREEN;
	}
}

 int Fibonacci_fl(int n)
{
  if (n < 2)
    return n;
  else
    return Fibonacci_fl(n-1) + Fibonacci_fl(n-2);
}
 
/* TODO:  Add any necessary local functions.
*/
void GPU_0_example(uint32_t fb, uint32_t color);

void example(void);

// *****************************************************************************
// *****************************************************************************
// Section: Application Initialization and State Machine Functions
// *****************************************************************************
// *****************************************************************************

/*******************************************************************************
  Function:
    void APP_Initialize ( void )

  Remarks:
    See prototype in app.h.
 */

void APP_Initialize ( void )
{
    /* Place the App state machine in its initial state. */
    appData.state = APP_STATE_INIT;



    /* TODO: Initialize your application's state machine and other
     * parameters.
     */
}


/******************************************************************************
  Function:
    void APP_Tasks ( void )

  Remarks:
    See prototype in app.h.
 */

void APP_Tasks ( void )
{

    /* Check the application's current state. */
    switch ( appData.state )
    {
        /* Application's initial state. */
        case APP_STATE_INIT:
        {
            bool appInitialized = true;


            if (appInitialized)
            {

                appData.state = APP_STATE_SERVICE_TASKS;
            }
            break;
        }

        case APP_STATE_SERVICE_TASKS:
        {
//            GPU_0_example(*fb, 0x00000000);
            appData.state = APP_STATE_IDLE;
            
            break;
        }

        /* TODO: implement your application state machine.*/


        /* The default state should never be executed. */
        default:
        {
            /* TODO: Handle error in application's state machine. */
            break;
        }
    }
}

/*
 * Example of accessing external bus memory
 */
void EXTERNAL_BUS_0_example(void)
{
	volatile uint32_t *pu32 = (uint32_t *)MEM_BASE;
	volatile uint16_t *pu16 = (uint16_t *)MEM_BASE;
	volatile uint8_t * pu8  = (uint8_t *)MEM_BASE;
	/* Backup one WORD */
//	uint32_t bak = _ext_bus_read_u32((void *)pu32);
	/* Write and verify BYTE */
	*pu8 = 0xAA;
	if (*pu8 != 0xAA) {
		/* Error ! */
		while (1)
			;
	}
	*pu8 = 0x55;
	if (*pu8 != 0x55) {
		/* Error ! */
		while (1)
			;
	}

	/* Write and verify HALF WORD */
	*pu16 = 0xAAAA;
	if (*pu16 != 0xAAAA) {
		/* Error ! */
		while (1)
			;
	}
	*pu16 = 0x5555;
	if (*pu16 != 0x5555) {
		/* Error ! */
		while (1)
			;
	}

	/* Write and verify WORD */
	*pu32 = 0xAAAA5555;
	if (*pu32 != 0xAAAA5555) {
		/* Error ! */
		while (1)
			;
	}
	*pu32 = 0x5A5A55AA;
	if (*pu32 != 0x5A5A55AA) {
		/* Error ! */
		while (1)
			;
	}
	/* Restore one WORD */
//	_ext_bus_write_u32((void *)pu32, bak);
}

/* Indicate end of execute instruction */
volatile uint8_t gpu_end = 0;

void gpu_cb(uint8_t state)
{
	gpu_end = state;
}

/**
 * Example of using GPU driver to fill a framebuffer(10*10 pixel) with blue color.
 * The Application must allocate framebuffer firstly.
 *
 * Example:
 *   # include <utils.h>
 *   COMPILER_ALIGNED(4)    uint32_t framebuffer[100]; // Frame buffer for 10x10 pixel, ARGB 32bit format
 * 
 *   // Call example function in main
 *   GPU_0_example(framebuffer, GPU_COLOR(0xFF, 0, 0, 0xFF));
 *
 */
void GPU_0_example(uint32_t fb, uint32_t color)
{
//	struct gpu_buffer    dst, src;
//	struct gpu_rectangle rect, src_rect;
//	uint32_t             i;
//
////	gpu_async_enable();
////	gpu_async_register_callback(gpu_cb);
//
//	dst.width  = 10;
//	dst.height = 10;
//	dst.fmt    = GPU_ARGB8888;
//	dst.addr   = fb;
//
//    src.width  = 10;
//	src.height = 10;
//	src.fmt    = GPU_ARGB8888;
//	src.addr   = fb;
//    
//	rect.x      = 0;
//	rect.y      = 0;
//	rect.width  = 10;
//	rect.height = 10;
//
//    src_rect.x      = 0;
//	src_rect.y      = 0;
//	src_rect.width  = 10;
//	src_rect.height = 10;
//    
////	gpu_async_fill(&dst, &rect, color);
////
////    gpu_async_copy(&dst, &rect, &src, &src_rect);
//    
//	/* Wait for instruction process */
//	while (gpu_end == 0) {
//	};
//
//	for (i = 0; i < 100; i++) {
//		if (((uint32_t *)fb)[i] != color) {
//			/* All memory should fill with color */
//			while (1) {
//			};
//		}
//	}
}

/**
 * Example of using LCD driver to shown framebuffer. The framebuffer was
 * allocated by application, normally in SDRAM. And the size of the framebuffer
 * was depend on LCD size and bpp size (Bits per pixel) which defined in LCD's
 * configurations.
 * For example if LCD size is 480 * 320, and bpp is 32bits. Then the framebuffer
 * size is 480 * 320 * 4bytes.
 */
void GRAPHIC_LCD_0_example(void *fb)
{
//	lcd_enable();
//	lcd_show(0, fb);
//	lcd_set_visible(0, 1);
}



/*******************************************************************************
 End of File
 */
